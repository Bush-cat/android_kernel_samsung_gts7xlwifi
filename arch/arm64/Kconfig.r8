## arch/arm64/Kconfig.r8
```kconfig
#
# Samsung R8 Projects
#
config MACH_R8Q_USA_SINGLE
	default n
	bool "Samsung R8Q USA SQ"
	help
	  Support for Samsung R8Q USA SQ device.

config MACH_R8Q_EUR_OPEN
	default n
	bool "Samsung R8Q EUR OPEN"
	help
	  Support for Samsung R8Q EUR OPEN device.

config MACH_R8Q_KOR_SINGLE
	default n
	bool "Samsung R8Q KOR SINGLE"
	help
	  Support for Samsung R8Q KOR SINGLE device.

config MACH_R8Q_CHN_OPEN
	default n
	bool "Samsung R8Q CHN OPEN"
	help
	  Support for Samsung R8Q CHN OPEN device.
```
